## Documentation/devicetree/bindings/pci/qcom,pcie-sa8797p.yaml
```yaml
# SPDX-License-Identifier: (GPL-2.0-only OR BSD-2-Clause)
%YAML 1.2
---
$id: http://devicetree.org/schemas/pci/qcom,pcie-sa8797p.yaml#
$schema: http://devicetree.org/meta-schemas/core.yaml#

title: Qualcomm SA8797P firmware-managed PCIe Root Complex

maintainers:
  - Bjorn Andersson <andersson@kernel.org>
  - Manivannan Sadhasivam <mani@kernel.org>

description:
  The Qualcomm SA8797P PCIe Root Complex is based on the DesignWare PCIe IP.
  It is managed by firmware and exposes an ECAM-compliant configuration space
  to the operating system.

properties:
  compatible:
    const: qcom,pcie-sa8797p

  reg:
    description:
      ECAM region used to access the PCI configuration space. The base address
      corresponds to the first bus in the bus-range property.
    maxItems: 1

  ranges:
    minItems: 1
    maxItems: 3

  power-domains:
    maxItems: 1

  dma-coherent: true
  iommu-map: true

required:
  - compatible
  - reg
  - ranges
  - power-domains
  - msi-map

allOf:
  - $ref: /schemas/pci/pci-host-bridge.yaml#

unevaluatedProperties: false

examples:
  - |
    #include <dt-bindings/interrupt-controller/arm-gic.h>

    soc {
        #address-cells = <2>;
        #size-cells = <2>;

        pci@4800000000 {
            compatible = "qcom,pcie-sa8797p";
            reg = <0x48 0x00000000 0x0 0x10000000>;
            device_type = "pci";

            #address-cells = <3>;
            #size-cells = <2>;

            ranges = <0x01000000 0x0 0x50000000 0x0 0x50000000
                      0x0 0x100000>,
                     <0x02000000 0x0 0x50100000 0x0 0x50100000
                      0x0 0x7000000>,
                     <0x43000000 0x48 0x10100000 0x48 0x10100000
                      0x4 0x00000000>;
            bus-range = <0x00 0xff>;
            linux,pci-domain = <1>;

            #interrupt-cells = <1>;
            interrupt-map-mask = <0 0 0 0x7>;
            interrupt-map = <0 0 0 1 &intc 0 0 GIC_SPI 835 IRQ_TYPE_LEVEL_HIGH>,
                            <0 0 0 2 &intc 0 0 GIC_SPI 351 IRQ_TYPE_LEVEL_HIGH>,
                            <0 0 0 3 &intc 0 0 GIC_SPI 830 IRQ_TYPE_LEVEL_HIGH>,
                            <0 0 0 4 &intc 0 0 GIC_SPI 348 IRQ_TYPE_LEVEL_HIGH>;

            dma-coherent;
            iommu-map = <0x000 &pcie_smmu 0x10000 0x1>,
                        <0x100 &pcie_smmu 0x10100 0x1>,
                        <0x200 &pcie_smmu 0x10200 0x1>,
                        <0x300 &pcie_smmu 0x10300 0x1>;
            msi-map = <0x0 &gic_its 0x90000 0x10000>;
            power-domains = <&scmi6_pd 0>;
        };
    };
```

## Documentation/devicetree/bindings/phy/qcom,sa8797p-snps-eusb2-phy.yaml
```yaml
# SPDX-License-Identifier: (GPL-2.0 OR BSD-2-Clause)
%YAML 1.2
---
$id: http://devicetree.org/schemas/phy/qcom,sa8797p-snps-eusb2-phy.yaml#
$schema: http://devicetree.org/meta-schemas/core.yaml#

title: Qualcomm SA8797P Synopsys eUSB2 PHY

maintainers:
  - Hiren Gohel <hiren.gohel@oss.qualcomm.com>

description:
  The Qualcomm SA8797P platform delegates control of the eUSB2 PHY clocks,
  reset, and other platform resources to firmware. The SCMI power protocol
  exposes two power domains for the PHY. The core domain controls the PHY
  power, reset, and clocks, while the transfer domain controls the clocks used
  for data transfer. The SCMI performance domain is not required for PHY
  operation and its opaque performance values are not part of this binding.

properties:
  compatible:
    const: qcom,sa8797p-snps-eusb2-phy

  reg:
    maxItems: 1

  "#phy-cells":
    const: 0

  power-domains:
    items:
      - description: Core domain controlling PHY power, reset, and clocks
      - description: Transfer domain controlling the data-transfer clocks

  power-domain-names:
    items:
      - const: core
      - const: transfer

  phys:
    maxItems: 1
    description:
      Phandle to the eUSB2 to USB 2.0 repeater.

required:
  - compatible
  - reg
  - "#phy-cells"
  - power-domains
  - power-domain-names

additionalProperties: false

examples:
  - |
    soc {
        #address-cells = <2>;
        #size-cells = <2>;

        phy@88e3000 {
            compatible = "qcom,sa8797p-snps-eusb2-phy";
            reg = <0x0 0x088e3000 0x0 0x154>;
            #phy-cells = <0>;

            power-domains = <&scmi12_pd 1>, <&scmi12_pd 0>;
            power-domain-names = "core", "transfer";
        };
    };
```
